#include "speaker.h"
#include "es8311_audio_codec.h"
#include "i2c_device.h"

#define TAG   "Speaker"

unsigned char g_filler_data[12144] = {
	0x52, 0x49, 0x46, 0x46, 0x68, 0x2F, 0x00, 0x00, 0x57, 0x41, 0x56, 0x45,
	0x66, 0x6D, 0x74, 0x20, 0x10, 0x00, 0x00, 0x00, 0x01, 0x00, 0x02, 0x00,
	0x80, 0x3E, 0x00, 0x00, 0x00, 0xFA, 0x00, 0x00, 0x04, 0x00, 0x10, 0x00,
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	0x00, 0x00, 0xFF, 0xFF, 0xFF, 0xFF, 0x00, 0x00, 0x00, 0x00, 0xFF, 0xFF
};

class Cst816d : public I2cDevice {
public:
  struct TouchPoint_t {
    int num = 0;
    int x = -1;
    int y = -1;
  };
  Cst816d(i2c_master_bus_handle_t i2c_bus, uint8_t addr) : I2cDevice(i2c_bus, addr) {
    uint8_t chip_id = ReadReg(0xA3);
    ESP_LOGI(TAG, "Get chip ID: 0x%02X", chip_id);
    read_buffer_ = new uint8_t[6];
  }

  ~Cst816d() {
    delete[] read_buffer_;
  }

  void UpdateTouchPoint() {
    ReadRegs(0x02, read_buffer_, 6);
    if (read_buffer_[0] == 0xFF)
    {
        read_buffer_[0] = 0x00;
    }
    tp_.num = read_buffer_[0] & 0x01;
    tp_.x = ((read_buffer_[1] & 0x0F) << 8) | read_buffer_[2];
    tp_.y = ((read_buffer_[3] & 0x0F) << 8) | read_buffer_[4];
  }

  const TouchPoint_t& GetTouchPoint() {
    return tp_;
  }

private:
  uint8_t* read_buffer_ = nullptr;
  TouchPoint_t tp_;
};

Speaker *Speaker::GetInstance()
{
  static Speaker *instance = nullptr;
  if (instance == nullptr) {
    instance = new Speaker();
  }
  return instance;
}

Speaker::Speaker()
{
  gpio_set_direction(TP_PIN_NUM_TP_INT, GPIO_MODE_INPUT);
  int level = gpio_get_level(TP_PIN_NUM_TP_INT);
  if (level == 1) {
    InitializeCodecI2c_Touch();
    InitializeCst816DTouchPad();
  } else {
    log_w("TouchPad not found!");
  }

  InitializeCodecI2c();
}

Speaker::~Speaker(){}

void Speaker::PlayFiller() {
  auto codec = GetAudioCodec();
  std::vector<int16_t> data(reinterpret_cast<int16_t*>(g_filler_data),
                            reinterpret_cast<int16_t*>(g_filler_data + sizeof(g_filler_data)));
  codec->OutputData(data);
}

void Speaker::InitializeCodecI2c() {
  // Initialize I2C peripheral
  i2c_master_bus_config_t i2c_bus_cfg = {
    .i2c_port = I2C_NUM_0,
    .sda_io_num = AUDIO_CODEC_I2C_SDA_PIN,
    .scl_io_num = AUDIO_CODEC_I2C_SCL_PIN,
    .clk_source = I2C_CLK_SRC_DEFAULT,
    .glitch_ignore_cnt = 7,
    .intr_priority = 0,
    .trans_queue_depth = 0,
    .flags = {
      .enable_internal_pullup = 1,
    },
  };
  ESP_ERROR_CHECK(i2c_new_master_bus(&i2c_bus_cfg, &codec_i2c_bus_));
}

void Speaker::InitializeCodecI2c_Touch() {
    // Initialize I2C peripheral
    i2c_master_bus_config_t i2c_bus_cfg = {
      .i2c_port = I2C_NUM_1,
      .sda_io_num = TP_PIN_NUM_TP_SDA,
      .scl_io_num = TP_PIN_NUM_TP_SCL,
      .clk_source = I2C_CLK_SRC_DEFAULT,
      .glitch_ignore_cnt = 7,
      .intr_priority = 0,
      .trans_queue_depth = 0,
      .flags = {
        .enable_internal_pullup = 1,
      },
    };
    ESP_ERROR_CHECK(i2c_new_master_bus(&i2c_bus_cfg, &i2c_bus_));
}

void Speaker::InitializeCst816DTouchPad() {
  ESP_LOGI(TAG, "Init Cst816D");
  cst816d_ = new Cst816d(i2c_bus_, 0x15);

  // 创建定时器，10ms 间隔
  esp_timer_create_args_t timer_args = {
      .callback = touchpad_timer_callback,
      .arg = NULL,
      .dispatch_method = ESP_TIMER_TASK,
      .name = "touchpad_timer",
      .skip_unhandled_events = true,
  };

  ESP_ERROR_CHECK(esp_timer_create(&timer_args, &touchpad_timer_));
  ESP_ERROR_CHECK(esp_timer_start_periodic(touchpad_timer_, 10 * 1000)); // 10ms = 10000us
}

void Speaker::touchpad_timer_callback(void* arg) {
    Speaker *board = Speaker::GetInstance();
    auto touchpad = board->GetTouchpad();
    static bool was_touched = false;
    static int64_t touch_start_time = 0;
    const int64_t TOUCH_THRESHOLD_MS = 500;  // 触摸时长阈值，超过500ms视为长按

    touchpad->UpdateTouchPoint();
    auto touch_point = touchpad->GetTouchPoint();

    // 检测触摸开始
    if (touch_point.num > 0 && !was_touched) {
        was_touched = true;
        touch_start_time = esp_timer_get_time() / 1000; // 转换为毫秒
    }
    // 检测触摸释放
    else if (touch_point.num == 0 && was_touched) {
        was_touched = false;
        int64_t touch_duration = (esp_timer_get_time() / 1000) - touch_start_time;

        // 只有短触才触发
        if (touch_duration < TOUCH_THRESHOLD_MS) {
            // auto& app = Application::GetInstance();
            // if (app.GetDeviceState() == kDeviceStateStarting &&
            //     !WifiStation::GetInstance().IsConnected()) {
            //     board.ResetWifiConfiguration();
            // }
            // app.ToggleChatState();
        }
    }
}

AudioCodec* Speaker::GetAudioCodec() {
  static Es8311AudioCodec audio_codec(codec_i2c_bus_, I2C_NUM_0, AUDIO_INPUT_SAMPLE_RATE, AUDIO_OUTPUT_SAMPLE_RATE,
    AUDIO_I2S_GPIO_MCLK, AUDIO_I2S_GPIO_BCLK, AUDIO_I2S_GPIO_WS, AUDIO_I2S_GPIO_DOUT, AUDIO_I2S_GPIO_DIN,
    AUDIO_CODEC_PA_PIN, AUDIO_CODEC_ES8311_ADDR);
  return &audio_codec;
}
